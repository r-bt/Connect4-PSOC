    IF :LNOT::DEF:INCLUDED_CYFITTERRV_INC
INCLUDED_CYFITTERRV_INC EQU 1
    GET cydevicerv.inc
    GET cydevicerv_trm.inc

; DC
DC__0__INTTYPE EQU CYREG_PICU2_INTTYPE5
DC__0__MASK EQU 0x20
DC__0__PC EQU CYREG_PRT2_PC5
DC__0__PORT EQU 2
DC__0__SHIFT EQU 5
DC__AG EQU CYREG_PRT2_AG
DC__AMUX EQU CYREG_PRT2_AMUX
DC__BIE EQU CYREG_PRT2_BIE
DC__BIT_MASK EQU CYREG_PRT2_BIT_MASK
DC__BYP EQU CYREG_PRT2_BYP
DC__CTL EQU CYREG_PRT2_CTL
DC__DM0 EQU CYREG_PRT2_DM0
DC__DM1 EQU CYREG_PRT2_DM1
DC__DM2 EQU CYREG_PRT2_DM2
DC__DR EQU CYREG_PRT2_DR
DC__INP_DIS EQU CYREG_PRT2_INP_DIS
DC__INTTYPE_BASE EQU CYDEV_PICU_INTTYPE_PICU2_BASE
DC__LCD_COM_SEG EQU CYREG_PRT2_LCD_COM_SEG
DC__LCD_EN EQU CYREG_PRT2_LCD_EN
DC__MASK EQU 0x20
DC__PORT EQU 2
DC__PRT EQU CYREG_PRT2_PRT
DC__PRTDSI__CAPS_SEL EQU CYREG_PRT2_CAPS_SEL
DC__PRTDSI__DBL_SYNC_IN EQU CYREG_PRT2_DBL_SYNC_IN
DC__PRTDSI__OE_SEL0 EQU CYREG_PRT2_OE_SEL0
DC__PRTDSI__OE_SEL1 EQU CYREG_PRT2_OE_SEL1
DC__PRTDSI__OUT_SEL0 EQU CYREG_PRT2_OUT_SEL0
DC__PRTDSI__OUT_SEL1 EQU CYREG_PRT2_OUT_SEL1
DC__PRTDSI__SYNC_OUT EQU CYREG_PRT2_SYNC_OUT
DC__PS EQU CYREG_PRT2_PS
DC__SHIFT EQU 5
DC__SLW EQU CYREG_PRT2_SLW

; SS
SS__0__INTTYPE EQU CYREG_PICU2_INTTYPE7
SS__0__MASK EQU 0x80
SS__0__PC EQU CYREG_PRT2_PC7
SS__0__PORT EQU 2
SS__0__SHIFT EQU 7
SS__AG EQU CYREG_PRT2_AG
SS__AMUX EQU CYREG_PRT2_AMUX
SS__BIE EQU CYREG_PRT2_BIE
SS__BIT_MASK EQU CYREG_PRT2_BIT_MASK
SS__BYP EQU CYREG_PRT2_BYP
SS__CTL EQU CYREG_PRT2_CTL
SS__DM0 EQU CYREG_PRT2_DM0
SS__DM1 EQU CYREG_PRT2_DM1
SS__DM2 EQU CYREG_PRT2_DM2
SS__DR EQU CYREG_PRT2_DR
SS__INP_DIS EQU CYREG_PRT2_INP_DIS
SS__INTTYPE_BASE EQU CYDEV_PICU_INTTYPE_PICU2_BASE
SS__LCD_COM_SEG EQU CYREG_PRT2_LCD_COM_SEG
SS__LCD_EN EQU CYREG_PRT2_LCD_EN
SS__MASK EQU 0x80
SS__PORT EQU 2
SS__PRT EQU CYREG_PRT2_PRT
SS__PRTDSI__CAPS_SEL EQU CYREG_PRT2_CAPS_SEL
SS__PRTDSI__DBL_SYNC_IN EQU CYREG_PRT2_DBL_SYNC_IN
SS__PRTDSI__OE_SEL0 EQU CYREG_PRT2_OE_SEL0
SS__PRTDSI__OE_SEL1 EQU CYREG_PRT2_OE_SEL1
SS__PRTDSI__OUT_SEL0 EQU CYREG_PRT2_OUT_SEL0
SS__PRTDSI__OUT_SEL1 EQU CYREG_PRT2_OUT_SEL1
SS__PRTDSI__SYNC_OUT EQU CYREG_PRT2_SYNC_OUT
SS__PS EQU CYREG_PRT2_PS
SS__SHIFT EQU 7
SS__SLW EQU CYREG_PRT2_SLW

; LED
LED__0__INTTYPE EQU CYREG_PICU2_INTTYPE2
LED__0__MASK EQU 0x04
LED__0__PC EQU CYREG_PRT2_PC2
LED__0__PORT EQU 2
LED__0__SHIFT EQU 2
LED__AG EQU CYREG_PRT2_AG
LED__AMUX EQU CYREG_PRT2_AMUX
LED__BIE EQU CYREG_PRT2_BIE
LED__BIT_MASK EQU CYREG_PRT2_BIT_MASK
LED__BYP EQU CYREG_PRT2_BYP
LED__CTL EQU CYREG_PRT2_CTL
LED__DM0 EQU CYREG_PRT2_DM0
LED__DM1 EQU CYREG_PRT2_DM1
LED__DM2 EQU CYREG_PRT2_DM2
LED__DR EQU CYREG_PRT2_DR
LED__INP_DIS EQU CYREG_PRT2_INP_DIS
LED__INTTYPE_BASE EQU CYDEV_PICU_INTTYPE_PICU2_BASE
LED__LCD_COM_SEG EQU CYREG_PRT2_LCD_COM_SEG
LED__LCD_EN EQU CYREG_PRT2_LCD_EN
LED__MASK EQU 0x04
LED__PORT EQU 2
LED__PRT EQU CYREG_PRT2_PRT
LED__PRTDSI__CAPS_SEL EQU CYREG_PRT2_CAPS_SEL
LED__PRTDSI__DBL_SYNC_IN EQU CYREG_PRT2_DBL_SYNC_IN
LED__PRTDSI__OE_SEL0 EQU CYREG_PRT2_OE_SEL0
LED__PRTDSI__OE_SEL1 EQU CYREG_PRT2_OE_SEL1
LED__PRTDSI__OUT_SEL0 EQU CYREG_PRT2_OUT_SEL0
LED__PRTDSI__OUT_SEL1 EQU CYREG_PRT2_OUT_SEL1
LED__PRTDSI__SYNC_OUT EQU CYREG_PRT2_SYNC_OUT
LED__PS EQU CYREG_PRT2_PS
LED__SHIFT EQU 2
LED__SLW EQU CYREG_PRT2_SLW

; MISO
MISO__0__INTTYPE EQU CYREG_PICU2_INTTYPE1
MISO__0__MASK EQU 0x02
MISO__0__PC EQU CYREG_PRT2_PC1
MISO__0__PORT EQU 2
MISO__0__SHIFT EQU 1
MISO__AG EQU CYREG_PRT2_AG
MISO__AMUX EQU CYREG_PRT2_AMUX
MISO__BIE EQU CYREG_PRT2_BIE
MISO__BIT_MASK EQU CYREG_PRT2_BIT_MASK
MISO__BYP EQU CYREG_PRT2_BYP
MISO__CTL EQU CYREG_PRT2_CTL
MISO__DM0 EQU CYREG_PRT2_DM0
MISO__DM1 EQU CYREG_PRT2_DM1
MISO__DM2 EQU CYREG_PRT2_DM2
MISO__DR EQU CYREG_PRT2_DR
MISO__INP_DIS EQU CYREG_PRT2_INP_DIS
MISO__INTTYPE_BASE EQU CYDEV_PICU_INTTYPE_PICU2_BASE
MISO__LCD_COM_SEG EQU CYREG_PRT2_LCD_COM_SEG
MISO__LCD_EN EQU CYREG_PRT2_LCD_EN
MISO__MASK EQU 0x02
MISO__PORT EQU 2
MISO__PRT EQU CYREG_PRT2_PRT
MISO__PRTDSI__CAPS_SEL EQU CYREG_PRT2_CAPS_SEL
MISO__PRTDSI__DBL_SYNC_IN EQU CYREG_PRT2_DBL_SYNC_IN
MISO__PRTDSI__OE_SEL0 EQU CYREG_PRT2_OE_SEL0
MISO__PRTDSI__OE_SEL1 EQU CYREG_PRT2_OE_SEL1
MISO__PRTDSI__OUT_SEL0 EQU CYREG_PRT2_OUT_SEL0
MISO__PRTDSI__OUT_SEL1 EQU CYREG_PRT2_OUT_SEL1
MISO__PRTDSI__SYNC_OUT EQU CYREG_PRT2_SYNC_OUT
MISO__PS EQU CYREG_PRT2_PS
MISO__SHIFT EQU 1
MISO__SLW EQU CYREG_PRT2_SLW

; MOSI
MOSI__0__INTTYPE EQU CYREG_PICU2_INTTYPE4
MOSI__0__MASK EQU 0x10
MOSI__0__PC EQU CYREG_PRT2_PC4
MOSI__0__PORT EQU 2
MOSI__0__SHIFT EQU 4
MOSI__AG EQU CYREG_PRT2_AG
MOSI__AMUX EQU CYREG_PRT2_AMUX
MOSI__BIE EQU CYREG_PRT2_BIE
MOSI__BIT_MASK EQU CYREG_PRT2_BIT_MASK
MOSI__BYP EQU CYREG_PRT2_BYP
MOSI__CTL EQU CYREG_PRT2_CTL
MOSI__DM0 EQU CYREG_PRT2_DM0
MOSI__DM1 EQU CYREG_PRT2_DM1
MOSI__DM2 EQU CYREG_PRT2_DM2
MOSI__DR EQU CYREG_PRT2_DR
MOSI__INP_DIS EQU CYREG_PRT2_INP_DIS
MOSI__INTTYPE_BASE EQU CYDEV_PICU_INTTYPE_PICU2_BASE
MOSI__LCD_COM_SEG EQU CYREG_PRT2_LCD_COM_SEG
MOSI__LCD_EN EQU CYREG_PRT2_LCD_EN
MOSI__MASK EQU 0x10
MOSI__PORT EQU 2
MOSI__PRT EQU CYREG_PRT2_PRT
MOSI__PRTDSI__CAPS_SEL EQU CYREG_PRT2_CAPS_SEL
MOSI__PRTDSI__DBL_SYNC_IN EQU CYREG_PRT2_DBL_SYNC_IN
MOSI__PRTDSI__OE_SEL0 EQU CYREG_PRT2_OE_SEL0
MOSI__PRTDSI__OE_SEL1 EQU CYREG_PRT2_OE_SEL1
MOSI__PRTDSI__OUT_SEL0 EQU CYREG_PRT2_OUT_SEL0
MOSI__PRTDSI__OUT_SEL1 EQU CYREG_PRT2_OUT_SEL1
MOSI__PRTDSI__SYNC_OUT EQU CYREG_PRT2_SYNC_OUT
MOSI__PS EQU CYREG_PRT2_PS
MOSI__SHIFT EQU 4
MOSI__SLW EQU CYREG_PRT2_SLW

; SCLK
SCLK__0__INTTYPE EQU CYREG_PICU2_INTTYPE3
SCLK__0__MASK EQU 0x08
SCLK__0__PC EQU CYREG_PRT2_PC3
SCLK__0__PORT EQU 2
SCLK__0__SHIFT EQU 3
SCLK__AG EQU CYREG_PRT2_AG
SCLK__AMUX EQU CYREG_PRT2_AMUX
SCLK__BIE EQU CYREG_PRT2_BIE
SCLK__BIT_MASK EQU CYREG_PRT2_BIT_MASK
SCLK__BYP EQU CYREG_PRT2_BYP
SCLK__CTL EQU CYREG_PRT2_CTL
SCLK__DM0 EQU CYREG_PRT2_DM0
SCLK__DM1 EQU CYREG_PRT2_DM1
SCLK__DM2 EQU CYREG_PRT2_DM2
SCLK__DR EQU CYREG_PRT2_DR
SCLK__INP_DIS EQU CYREG_PRT2_INP_DIS
SCLK__INTTYPE_BASE EQU CYDEV_PICU_INTTYPE_PICU2_BASE
SCLK__LCD_COM_SEG EQU CYREG_PRT2_LCD_COM_SEG
SCLK__LCD_EN EQU CYREG_PRT2_LCD_EN
SCLK__MASK EQU 0x08
SCLK__PORT EQU 2
SCLK__PRT EQU CYREG_PRT2_PRT
SCLK__PRTDSI__CAPS_SEL EQU CYREG_PRT2_CAPS_SEL
SCLK__PRTDSI__DBL_SYNC_IN EQU CYREG_PRT2_DBL_SYNC_IN
SCLK__PRTDSI__OE_SEL0 EQU CYREG_PRT2_OE_SEL0
SCLK__PRTDSI__OE_SEL1 EQU CYREG_PRT2_OE_SEL1
SCLK__PRTDSI__OUT_SEL0 EQU CYREG_PRT2_OUT_SEL0
SCLK__PRTDSI__OUT_SEL1 EQU CYREG_PRT2_OUT_SEL1
SCLK__PRTDSI__SYNC_OUT EQU CYREG_PRT2_SYNC_OUT
SCLK__PS EQU CYREG_PRT2_PS
SCLK__SHIFT EQU 3
SCLK__SLW EQU CYREG_PRT2_SLW

; T_CS
T_CS__0__INTTYPE EQU CYREG_PICU5_INTTYPE2
T_CS__0__MASK EQU 0x04
T_CS__0__PC EQU CYREG_PRT5_PC2
T_CS__0__PORT EQU 5
T_CS__0__SHIFT EQU 2
T_CS__AG EQU CYREG_PRT5_AG
T_CS__AMUX EQU CYREG_PRT5_AMUX
T_CS__BIE EQU CYREG_PRT5_BIE
T_CS__BIT_MASK EQU CYREG_PRT5_BIT_MASK
T_CS__BYP EQU CYREG_PRT5_BYP
T_CS__CTL EQU CYREG_PRT5_CTL
T_CS__DM0 EQU CYREG_PRT5_DM0
T_CS__DM1 EQU CYREG_PRT5_DM1
T_CS__DM2 EQU CYREG_PRT5_DM2
T_CS__DR EQU CYREG_PRT5_DR
T_CS__INP_DIS EQU CYREG_PRT5_INP_DIS
T_CS__INTTYPE_BASE EQU CYDEV_PICU_INTTYPE_PICU5_BASE
T_CS__LCD_COM_SEG EQU CYREG_PRT5_LCD_COM_SEG
T_CS__LCD_EN EQU CYREG_PRT5_LCD_EN
T_CS__MASK EQU 0x04
T_CS__PORT EQU 5
T_CS__PRT EQU CYREG_PRT5_PRT
T_CS__PRTDSI__CAPS_SEL EQU CYREG_PRT5_CAPS_SEL
T_CS__PRTDSI__DBL_SYNC_IN EQU CYREG_PRT5_DBL_SYNC_IN
T_CS__PRTDSI__OE_SEL0 EQU CYREG_PRT5_OE_SEL0
T_CS__PRTDSI__OE_SEL1 EQU CYREG_PRT5_OE_SEL1
T_CS__PRTDSI__OUT_SEL0 EQU CYREG_PRT5_OUT_SEL0
T_CS__PRTDSI__OUT_SEL1 EQU CYREG_PRT5_OUT_SEL1
T_CS__PRTDSI__SYNC_OUT EQU CYREG_PRT5_SYNC_OUT
T_CS__PS EQU CYREG_PRT5_PS
T_CS__SHIFT EQU 2
T_CS__SLW EQU CYREG_PRT5_SLW

; T_DO
T_DO__0__INTTYPE EQU CYREG_PICU5_INTTYPE4
T_DO__0__MASK EQU 0x10
T_DO__0__PC EQU CYREG_PRT5_PC4
T_DO__0__PORT EQU 5
T_DO__0__SHIFT EQU 4
T_DO__AG EQU CYREG_PRT5_AG
T_DO__AMUX EQU CYREG_PRT5_AMUX
T_DO__BIE EQU CYREG_PRT5_BIE
T_DO__BIT_MASK EQU CYREG_PRT5_BIT_MASK
T_DO__BYP EQU CYREG_PRT5_BYP
T_DO__CTL EQU CYREG_PRT5_CTL
T_DO__DM0 EQU CYREG_PRT5_DM0
T_DO__DM1 EQU CYREG_PRT5_DM1
T_DO__DM2 EQU CYREG_PRT5_DM2
T_DO__DR EQU CYREG_PRT5_DR
T_DO__INP_DIS EQU CYREG_PRT5_INP_DIS
T_DO__INTTYPE_BASE EQU CYDEV_PICU_INTTYPE_PICU5_BASE
T_DO__LCD_COM_SEG EQU CYREG_PRT5_LCD_COM_SEG
T_DO__LCD_EN EQU CYREG_PRT5_LCD_EN
T_DO__MASK EQU 0x10
T_DO__PORT EQU 5
T_DO__PRT EQU CYREG_PRT5_PRT
T_DO__PRTDSI__CAPS_SEL EQU CYREG_PRT5_CAPS_SEL
T_DO__PRTDSI__DBL_SYNC_IN EQU CYREG_PRT5_DBL_SYNC_IN
T_DO__PRTDSI__OE_SEL0 EQU CYREG_PRT5_OE_SEL0
T_DO__PRTDSI__OE_SEL1 EQU CYREG_PRT5_OE_SEL1
T_DO__PRTDSI__OUT_SEL0 EQU CYREG_PRT5_OUT_SEL0
T_DO__PRTDSI__OUT_SEL1 EQU CYREG_PRT5_OUT_SEL1
T_DO__PRTDSI__SYNC_OUT EQU CYREG_PRT5_SYNC_OUT
T_DO__PS EQU CYREG_PRT5_PS
T_DO__SHIFT EQU 4
T_DO__SLW EQU CYREG_PRT5_SLW

; RESET
RESET__0__INTTYPE EQU CYREG_PICU2_INTTYPE6
RESET__0__MASK EQU 0x40
RESET__0__PC EQU CYREG_PRT2_PC6
RESET__0__PORT EQU 2
RESET__0__SHIFT EQU 6
RESET__AG EQU CYREG_PRT2_AG
RESET__AMUX EQU CYREG_PRT2_AMUX
RESET__BIE EQU CYREG_PRT2_BIE
RESET__BIT_MASK EQU CYREG_PRT2_BIT_MASK
RESET__BYP EQU CYREG_PRT2_BYP
RESET__CTL EQU CYREG_PRT2_CTL
RESET__DM0 EQU CYREG_PRT2_DM0
RESET__DM1 EQU CYREG_PRT2_DM1
RESET__DM2 EQU CYREG_PRT2_DM2
RESET__DR EQU CYREG_PRT2_DR
RESET__INP_DIS EQU CYREG_PRT2_INP_DIS
RESET__INTTYPE_BASE EQU CYDEV_PICU_INTTYPE_PICU2_BASE
RESET__LCD_COM_SEG EQU CYREG_PRT2_LCD_COM_SEG
RESET__LCD_EN EQU CYREG_PRT2_LCD_EN
RESET__MASK EQU 0x40
RESET__PORT EQU 2
RESET__PRT EQU CYREG_PRT2_PRT
RESET__PRTDSI__CAPS_SEL EQU CYREG_PRT2_CAPS_SEL
RESET__PRTDSI__DBL_SYNC_IN EQU CYREG_PRT2_DBL_SYNC_IN
RESET__PRTDSI__OE_SEL0 EQU CYREG_PRT2_OE_SEL0
RESET__PRTDSI__OE_SEL1 EQU CYREG_PRT2_OE_SEL1
RESET__PRTDSI__OUT_SEL0 EQU CYREG_PRT2_OUT_SEL0
RESET__PRTDSI__OUT_SEL1 EQU CYREG_PRT2_OUT_SEL1
RESET__PRTDSI__SYNC_OUT EQU CYREG_PRT2_SYNC_OUT
RESET__PS EQU CYREG_PRT2_PS
RESET__SHIFT EQU 6
RESET__SLW EQU CYREG_PRT2_SLW

; T_CLK
T_CLK__0__INTTYPE EQU CYREG_PICU5_INTTYPE1
T_CLK__0__MASK EQU 0x02
T_CLK__0__PC EQU CYREG_PRT5_PC1
T_CLK__0__PORT EQU 5
T_CLK__0__SHIFT EQU 1
T_CLK__AG EQU CYREG_PRT5_AG
T_CLK__AMUX EQU CYREG_PRT5_AMUX
T_CLK__BIE EQU CYREG_PRT5_BIE
T_CLK__BIT_MASK EQU CYREG_PRT5_BIT_MASK
T_CLK__BYP EQU CYREG_PRT5_BYP
T_CLK__CTL EQU CYREG_PRT5_CTL
T_CLK__DM0 EQU CYREG_PRT5_DM0
T_CLK__DM1 EQU CYREG_PRT5_DM1
T_CLK__DM2 EQU CYREG_PRT5_DM2
T_CLK__DR EQU CYREG_PRT5_DR
T_CLK__INP_DIS EQU CYREG_PRT5_INP_DIS
T_CLK__INTTYPE_BASE EQU CYDEV_PICU_INTTYPE_PICU5_BASE
T_CLK__LCD_COM_SEG EQU CYREG_PRT5_LCD_COM_SEG
T_CLK__LCD_EN EQU CYREG_PRT5_LCD_EN
T_CLK__MASK EQU 0x02
T_CLK__PORT EQU 5
T_CLK__PRT EQU CYREG_PRT5_PRT
T_CLK__PRTDSI__CAPS_SEL EQU CYREG_PRT5_CAPS_SEL
T_CLK__PRTDSI__DBL_SYNC_IN EQU CYREG_PRT5_DBL_SYNC_IN
T_CLK__PRTDSI__OE_SEL0 EQU CYREG_PRT5_OE_SEL0
T_CLK__PRTDSI__OE_SEL1 EQU CYREG_PRT5_OE_SEL1
T_CLK__PRTDSI__OUT_SEL0 EQU CYREG_PRT5_OUT_SEL0
T_CLK__PRTDSI__OUT_SEL1 EQU CYREG_PRT5_OUT_SEL1
T_CLK__PRTDSI__SYNC_OUT EQU CYREG_PRT5_SYNC_OUT
T_CLK__PS EQU CYREG_PRT5_PS
T_CLK__SHIFT EQU 1
T_CLK__SLW EQU CYREG_PRT5_SLW

; T_DIN
T_DIN__0__INTTYPE EQU CYREG_PICU5_INTTYPE3
T_DIN__0__MASK EQU 0x08
T_DIN__0__PC EQU CYREG_PRT5_PC3
T_DIN__0__PORT EQU 5
T_DIN__0__SHIFT EQU 3
T_DIN__AG EQU CYREG_PRT5_AG
T_DIN__AMUX EQU CYREG_PRT5_AMUX
T_DIN__BIE EQU CYREG_PRT5_BIE
T_DIN__BIT_MASK EQU CYREG_PRT5_BIT_MASK
T_DIN__BYP EQU CYREG_PRT5_BYP
T_DIN__CTL EQU CYREG_PRT5_CTL
T_DIN__DM0 EQU CYREG_PRT5_DM0
T_DIN__DM1 EQU CYREG_PRT5_DM1
T_DIN__DM2 EQU CYREG_PRT5_DM2
T_DIN__DR EQU CYREG_PRT5_DR
T_DIN__INP_DIS EQU CYREG_PRT5_INP_DIS
T_DIN__INTTYPE_BASE EQU CYDEV_PICU_INTTYPE_PICU5_BASE
T_DIN__LCD_COM_SEG EQU CYREG_PRT5_LCD_COM_SEG
T_DIN__LCD_EN EQU CYREG_PRT5_LCD_EN
T_DIN__MASK EQU 0x08
T_DIN__PORT EQU 5
T_DIN__PRT EQU CYREG_PRT5_PRT
T_DIN__PRTDSI__CAPS_SEL EQU CYREG_PRT5_CAPS_SEL
T_DIN__PRTDSI__DBL_SYNC_IN EQU CYREG_PRT5_DBL_SYNC_IN
T_DIN__PRTDSI__OE_SEL0 EQU CYREG_PRT5_OE_SEL0
T_DIN__PRTDSI__OE_SEL1 EQU CYREG_PRT5_OE_SEL1
T_DIN__PRTDSI__OUT_SEL0 EQU CYREG_PRT5_OUT_SEL0
T_DIN__PRTDSI__OUT_SEL1 EQU CYREG_PRT5_OUT_SEL1
T_DIN__PRTDSI__SYNC_OUT EQU CYREG_PRT5_SYNC_OUT
T_DIN__PS EQU CYREG_PRT5_PS
T_DIN__SHIFT EQU 3
T_DIN__SLW EQU CYREG_PRT5_SLW

; T_IRQ
T_IRQ__0__INTTYPE EQU CYREG_PICU5_INTTYPE5
T_IRQ__0__MASK EQU 0x20
T_IRQ__0__PC EQU CYREG_PRT5_PC5
T_IRQ__0__PORT EQU 5
T_IRQ__0__SHIFT EQU 5
T_IRQ__AG EQU CYREG_PRT5_AG
T_IRQ__AMUX EQU CYREG_PRT5_AMUX
T_IRQ__BIE EQU CYREG_PRT5_BIE
T_IRQ__BIT_MASK EQU CYREG_PRT5_BIT_MASK
T_IRQ__BYP EQU CYREG_PRT5_BYP
T_IRQ__CTL EQU CYREG_PRT5_CTL
T_IRQ__DM0 EQU CYREG_PRT5_DM0
T_IRQ__DM1 EQU CYREG_PRT5_DM1
T_IRQ__DM2 EQU CYREG_PRT5_DM2
T_IRQ__DR EQU CYREG_PRT5_DR
T_IRQ__INP_DIS EQU CYREG_PRT5_INP_DIS
T_IRQ__INTTYPE_BASE EQU CYDEV_PICU_INTTYPE_PICU5_BASE
T_IRQ__LCD_COM_SEG EQU CYREG_PRT5_LCD_COM_SEG
T_IRQ__LCD_EN EQU CYREG_PRT5_LCD_EN
T_IRQ__MASK EQU 0x20
T_IRQ__PORT EQU 5
T_IRQ__PRT EQU CYREG_PRT5_PRT
T_IRQ__PRTDSI__CAPS_SEL EQU CYREG_PRT5_CAPS_SEL
T_IRQ__PRTDSI__DBL_SYNC_IN EQU CYREG_PRT5_DBL_SYNC_IN
T_IRQ__PRTDSI__OE_SEL0 EQU CYREG_PRT5_OE_SEL0
T_IRQ__PRTDSI__OE_SEL1 EQU CYREG_PRT5_OE_SEL1
T_IRQ__PRTDSI__OUT_SEL0 EQU CYREG_PRT5_OUT_SEL0
T_IRQ__PRTDSI__OUT_SEL1 EQU CYREG_PRT5_OUT_SEL1
T_IRQ__PRTDSI__SYNC_OUT EQU CYREG_PRT5_SYNC_OUT
T_IRQ__PS EQU CYREG_PRT5_PS
T_IRQ__SHIFT EQU 5
T_IRQ__SLW EQU CYREG_PRT5_SLW

; SPIM_1_BSPIM
SPIM_1_BSPIM_BitCounter__16BIT_CONTROL_AUX_CTL_REG EQU CYREG_B0_UDB13_14_ACTL
SPIM_1_BSPIM_BitCounter__16BIT_CONTROL_CONTROL_REG EQU CYREG_B0_UDB13_14_CTL
SPIM_1_BSPIM_BitCounter__16BIT_CONTROL_COUNT_REG EQU CYREG_B0_UDB13_14_CTL
SPIM_1_BSPIM_BitCounter__16BIT_COUNT_CONTROL_REG EQU CYREG_B0_UDB13_14_CTL
SPIM_1_BSPIM_BitCounter__16BIT_COUNT_COUNT_REG EQU CYREG_B0_UDB13_14_CTL
SPIM_1_BSPIM_BitCounter__16BIT_MASK_MASK_REG EQU CYREG_B0_UDB13_14_MSK
SPIM_1_BSPIM_BitCounter__16BIT_MASK_PERIOD_REG EQU CYREG_B0_UDB13_14_MSK
SPIM_1_BSPIM_BitCounter__16BIT_PERIOD_MASK_REG EQU CYREG_B0_UDB13_14_MSK
SPIM_1_BSPIM_BitCounter__16BIT_PERIOD_PERIOD_REG EQU CYREG_B0_UDB13_14_MSK
SPIM_1_BSPIM_BitCounter__CONTROL_AUX_CTL_REG EQU CYREG_B0_UDB13_ACTL
SPIM_1_BSPIM_BitCounter__CONTROL_REG EQU CYREG_B0_UDB13_CTL
SPIM_1_BSPIM_BitCounter__CONTROL_ST_REG EQU CYREG_B0_UDB13_ST_CTL
SPIM_1_BSPIM_BitCounter__COUNT_REG EQU CYREG_B0_UDB13_CTL
SPIM_1_BSPIM_BitCounter__COUNT_ST_REG EQU CYREG_B0_UDB13_ST_CTL
SPIM_1_BSPIM_BitCounter__MASK_CTL_AUX_CTL_REG EQU CYREG_B0_UDB13_MSK_ACTL
SPIM_1_BSPIM_BitCounter__PER_CTL_AUX_CTL_REG EQU CYREG_B0_UDB13_MSK_ACTL
SPIM_1_BSPIM_BitCounter__PERIOD_REG EQU CYREG_B0_UDB13_MSK
SPIM_1_BSPIM_BitCounter_ST__16BIT_STATUS_AUX_CTL_REG EQU CYREG_B0_UDB13_14_ACTL
SPIM_1_BSPIM_BitCounter_ST__16BIT_STATUS_REG EQU CYREG_B0_UDB13_14_ST
SPIM_1_BSPIM_BitCounter_ST__MASK_REG EQU CYREG_B0_UDB13_MSK
SPIM_1_BSPIM_BitCounter_ST__MASK_ST_AUX_CTL_REG EQU CYREG_B0_UDB13_MSK_ACTL
SPIM_1_BSPIM_BitCounter_ST__PER_ST_AUX_CTL_REG EQU CYREG_B0_UDB13_MSK_ACTL
SPIM_1_BSPIM_BitCounter_ST__STATUS_AUX_CTL_REG EQU CYREG_B0_UDB13_ACTL
SPIM_1_BSPIM_BitCounter_ST__STATUS_CNT_REG EQU CYREG_B0_UDB13_ST_CTL
SPIM_1_BSPIM_BitCounter_ST__STATUS_CONTROL_REG EQU CYREG_B0_UDB13_ST_CTL
SPIM_1_BSPIM_BitCounter_ST__STATUS_REG EQU CYREG_B0_UDB13_ST
SPIM_1_BSPIM_RxStsReg__16BIT_STATUS_AUX_CTL_REG EQU CYREG_B0_UDB14_15_ACTL
SPIM_1_BSPIM_RxStsReg__16BIT_STATUS_REG EQU CYREG_B0_UDB14_15_ST
SPIM_1_BSPIM_RxStsReg__4__MASK EQU 0x10
SPIM_1_BSPIM_RxStsReg__4__POS EQU 4
SPIM_1_BSPIM_RxStsReg__5__MASK EQU 0x20
SPIM_1_BSPIM_RxStsReg__5__POS EQU 5
SPIM_1_BSPIM_RxStsReg__6__MASK EQU 0x40
SPIM_1_BSPIM_RxStsReg__6__POS EQU 6
SPIM_1_BSPIM_RxStsReg__MASK EQU 0x70
SPIM_1_BSPIM_RxStsReg__MASK_REG EQU CYREG_B0_UDB14_MSK
SPIM_1_BSPIM_RxStsReg__STATUS_AUX_CTL_REG EQU CYREG_B0_UDB14_ACTL
SPIM_1_BSPIM_RxStsReg__STATUS_REG EQU CYREG_B0_UDB14_ST
SPIM_1_BSPIM_sR8_Dp_u0__16BIT_A0_REG EQU CYREG_B0_UDB13_14_A0
SPIM_1_BSPIM_sR8_Dp_u0__16BIT_A1_REG EQU CYREG_B0_UDB13_14_A1
SPIM_1_BSPIM_sR8_Dp_u0__16BIT_D0_REG EQU CYREG_B0_UDB13_14_D0
SPIM_1_BSPIM_sR8_Dp_u0__16BIT_D1_REG EQU CYREG_B0_UDB13_14_D1
SPIM_1_BSPIM_sR8_Dp_u0__16BIT_DP_AUX_CTL_REG EQU CYREG_B0_UDB13_14_ACTL
SPIM_1_BSPIM_sR8_Dp_u0__16BIT_F0_REG EQU CYREG_B0_UDB13_14_F0
SPIM_1_BSPIM_sR8_Dp_u0__16BIT_F1_REG EQU CYREG_B0_UDB13_14_F1
SPIM_1_BSPIM_sR8_Dp_u0__A0_A1_REG EQU CYREG_B0_UDB13_A0_A1
SPIM_1_BSPIM_sR8_Dp_u0__A0_REG EQU CYREG_B0_UDB13_A0
SPIM_1_BSPIM_sR8_Dp_u0__A1_REG EQU CYREG_B0_UDB13_A1
SPIM_1_BSPIM_sR8_Dp_u0__D0_D1_REG EQU CYREG_B0_UDB13_D0_D1
SPIM_1_BSPIM_sR8_Dp_u0__D0_REG EQU CYREG_B0_UDB13_D0
SPIM_1_BSPIM_sR8_Dp_u0__D1_REG EQU CYREG_B0_UDB13_D1
SPIM_1_BSPIM_sR8_Dp_u0__DP_AUX_CTL_REG EQU CYREG_B0_UDB13_ACTL
SPIM_1_BSPIM_sR8_Dp_u0__F0_F1_REG EQU CYREG_B0_UDB13_F0_F1
SPIM_1_BSPIM_sR8_Dp_u0__F0_REG EQU CYREG_B0_UDB13_F0
SPIM_1_BSPIM_sR8_Dp_u0__F1_REG EQU CYREG_B0_UDB13_F1
SPIM_1_BSPIM_sR8_Dp_u0__MSK_DP_AUX_CTL_REG EQU CYREG_B0_UDB13_MSK_ACTL
SPIM_1_BSPIM_sR8_Dp_u0__PER_DP_AUX_CTL_REG EQU CYREG_B0_UDB13_MSK_ACTL
SPIM_1_BSPIM_TxStsReg__0__MASK EQU 0x01
SPIM_1_BSPIM_TxStsReg__0__POS EQU 0
SPIM_1_BSPIM_TxStsReg__1__MASK EQU 0x02
SPIM_1_BSPIM_TxStsReg__1__POS EQU 1
SPIM_1_BSPIM_TxStsReg__2__MASK EQU 0x04
SPIM_1_BSPIM_TxStsReg__2__POS EQU 2
SPIM_1_BSPIM_TxStsReg__3__MASK EQU 0x08
SPIM_1_BSPIM_TxStsReg__3__POS EQU 3
SPIM_1_BSPIM_TxStsReg__4__MASK EQU 0x10
SPIM_1_BSPIM_TxStsReg__4__POS EQU 4
SPIM_1_BSPIM_TxStsReg__MASK EQU 0x1F
SPIM_1_BSPIM_TxStsReg__MASK_REG EQU CYREG_B0_UDB15_MSK
SPIM_1_BSPIM_TxStsReg__STATUS_AUX_CTL_REG EQU CYREG_B0_UDB15_ACTL
SPIM_1_BSPIM_TxStsReg__STATUS_REG EQU CYREG_B0_UDB15_ST

; Clock_1
Clock_1__CFG0 EQU CYREG_CLKDIST_DCFG0_CFG0
Clock_1__CFG1 EQU CYREG_CLKDIST_DCFG0_CFG1
Clock_1__CFG2 EQU CYREG_CLKDIST_DCFG0_CFG2
Clock_1__CFG2_SRC_SEL_MASK EQU 0x07
Clock_1__INDEX EQU 0x00
Clock_1__PM_ACT_CFG EQU CYREG_PM_ACT_CFG2
Clock_1__PM_ACT_MSK EQU 0x01
Clock_1__PM_STBY_CFG EQU CYREG_PM_STBY_CFG2
Clock_1__PM_STBY_MSK EQU 0x01

; USBUART_arb_int
USBUART_arb_int__INTC_CLR_EN_REG EQU CYREG_NVIC_CLRENA0
USBUART_arb_int__INTC_CLR_PD_REG EQU CYREG_NVIC_CLRPEND0
USBUART_arb_int__INTC_MASK EQU 0x400000
USBUART_arb_int__INTC_NUMBER EQU 22
USBUART_arb_int__INTC_PRIOR_NUM EQU 7
USBUART_arb_int__INTC_PRIOR_REG EQU CYREG_NVIC_PRI_22
USBUART_arb_int__INTC_SET_EN_REG EQU CYREG_NVIC_SETENA0
USBUART_arb_int__INTC_SET_PD_REG EQU CYREG_NVIC_SETPEND0

; USBUART_bus_reset
USBUART_bus_reset__INTC_CLR_EN_REG EQU CYREG_NVIC_CLRENA0
USBUART_bus_reset__INTC_CLR_PD_REG EQU CYREG_NVIC_CLRPEND0
USBUART_bus_reset__INTC_MASK EQU 0x800000
USBUART_bus_reset__INTC_NUMBER EQU 23
USBUART_bus_reset__INTC_PRIOR_NUM EQU 7
USBUART_bus_reset__INTC_PRIOR_REG EQU CYREG_NVIC_PRI_23
USBUART_bus_reset__INTC_SET_EN_REG EQU CYREG_NVIC_SETENA0
USBUART_bus_reset__INTC_SET_PD_REG EQU CYREG_NVIC_SETPEND0

; USBUART_Dm
USBUART_Dm__0__INTTYPE EQU CYREG_PICU15_INTTYPE7
USBUART_Dm__0__MASK EQU 0x80
USBUART_Dm__0__PC EQU CYREG_IO_PC_PRT15_7_6_PC1
USBUART_Dm__0__PORT EQU 15
USBUART_Dm__0__SHIFT EQU 7
USBUART_Dm__AG EQU CYREG_PRT15_AG
USBUART_Dm__AMUX EQU CYREG_PRT15_AMUX
USBUART_Dm__BIE EQU CYREG_PRT15_BIE
USBUART_Dm__BIT_MASK EQU CYREG_PRT15_BIT_MASK
USBUART_Dm__BYP EQU CYREG_PRT15_BYP
USBUART_Dm__CTL EQU CYREG_PRT15_CTL
USBUART_Dm__DM0 EQU CYREG_PRT15_DM0
USBUART_Dm__DM1 EQU CYREG_PRT15_DM1
USBUART_Dm__DM2 EQU CYREG_PRT15_DM2
USBUART_Dm__DR EQU CYREG_PRT15_DR
USBUART_Dm__INP_DIS EQU CYREG_PRT15_INP_DIS
USBUART_Dm__INTTYPE_BASE EQU CYDEV_PICU_INTTYPE_PICU15_BASE
USBUART_Dm__LCD_COM_SEG EQU CYREG_PRT15_LCD_COM_SEG
USBUART_Dm__LCD_EN EQU CYREG_PRT15_LCD_EN
USBUART_Dm__MASK EQU 0x80
USBUART_Dm__PORT EQU 15
USBUART_Dm__PRT EQU CYREG_PRT15_PRT
USBUART_Dm__PRTDSI__CAPS_SEL EQU CYREG_PRT15_CAPS_SEL
USBUART_Dm__PRTDSI__DBL_SYNC_IN EQU CYREG_PRT15_DBL_SYNC_IN
USBUART_Dm__PRTDSI__OE_SEL0 EQU CYREG_PRT15_OE_SEL0
USBUART_Dm__PRTDSI__OE_SEL1 EQU CYREG_PRT15_OE_SEL1
USBUART_Dm__PRTDSI__OUT_SEL0 EQU CYREG_PRT15_OUT_SEL0
USBUART_Dm__PRTDSI__OUT_SEL1 EQU CYREG_PRT15_OUT_SEL1
USBUART_Dm__PRTDSI__SYNC_OUT EQU CYREG_PRT15_SYNC_OUT
USBUART_Dm__PS EQU CYREG_PRT15_PS
USBUART_Dm__SHIFT EQU 7
USBUART_Dm__SLW EQU CYREG_PRT15_SLW

; USBUART_Dp
USBUART_Dp__0__INTTYPE EQU CYREG_PICU15_INTTYPE6
USBUART_Dp__0__MASK EQU 0x40
USBUART_Dp__0__PC EQU CYREG_IO_PC_PRT15_7_6_PC0
USBUART_Dp__0__PORT EQU 15
USBUART_Dp__0__SHIFT EQU 6
USBUART_Dp__AG EQU CYREG_PRT15_AG
USBUART_Dp__AMUX EQU CYREG_PRT15_AMUX
USBUART_Dp__BIE EQU CYREG_PRT15_BIE
USBUART_Dp__BIT_MASK EQU CYREG_PRT15_BIT_MASK
USBUART_Dp__BYP EQU CYREG_PRT15_BYP
USBUART_Dp__CTL EQU CYREG_PRT15_CTL
USBUART_Dp__DM0 EQU CYREG_PRT15_DM0
USBUART_Dp__DM1 EQU CYREG_PRT15_DM1
USBUART_Dp__DM2 EQU CYREG_PRT15_DM2
USBUART_Dp__DR EQU CYREG_PRT15_DR
USBUART_Dp__INP_DIS EQU CYREG_PRT15_INP_DIS
USBUART_Dp__INTSTAT EQU CYREG_PICU15_INTSTAT
USBUART_Dp__INTTYPE_BASE EQU CYDEV_PICU_INTTYPE_PICU15_BASE
USBUART_Dp__LCD_COM_SEG EQU CYREG_PRT15_LCD_COM_SEG
USBUART_Dp__LCD_EN EQU CYREG_PRT15_LCD_EN
USBUART_Dp__MASK EQU 0x40
USBUART_Dp__PORT EQU 15
USBUART_Dp__PRT EQU CYREG_PRT15_PRT
USBUART_Dp__PRTDSI__CAPS_SEL EQU CYREG_PRT15_CAPS_SEL
USBUART_Dp__PRTDSI__DBL_SYNC_IN EQU CYREG_PRT15_DBL_SYNC_IN
USBUART_Dp__PRTDSI__OE_SEL0 EQU CYREG_PRT15_OE_SEL0
USBUART_Dp__PRTDSI__OE_SEL1 EQU CYREG_PRT15_OE_SEL1
USBUART_Dp__PRTDSI__OUT_SEL0 EQU CYREG_PRT15_OUT_SEL0
USBUART_Dp__PRTDSI__OUT_SEL1 EQU CYREG_PRT15_OUT_SEL1
USBUART_Dp__PRTDSI__SYNC_OUT EQU CYREG_PRT15_SYNC_OUT
USBUART_Dp__PS EQU CYREG_PRT15_PS
USBUART_Dp__SHIFT EQU 6
USBUART_Dp__SLW EQU CYREG_PRT15_SLW
USBUART_Dp__SNAP EQU CYREG_PICU_15_SNAP_15

; USBUART_dp_int
USBUART_dp_int__INTC_CLR_EN_REG EQU CYREG_NVIC_CLRENA0
USBUART_dp_int__INTC_CLR_PD_REG EQU CYREG_NVIC_CLRPEND0
USBUART_dp_int__INTC_MASK EQU 0x1000
USBUART_dp_int__INTC_NUMBER EQU 12
USBUART_dp_int__INTC_PRIOR_NUM EQU 7
USBUART_dp_int__INTC_PRIOR_REG EQU CYREG_NVIC_PRI_12
USBUART_dp_int__INTC_SET_EN_REG EQU CYREG_NVIC_SETENA0
USBUART_dp_int__INTC_SET_PD_REG EQU CYREG_NVIC_SETPEND0

; USBUART_ep_0
USBUART_ep_0__INTC_CLR_EN_REG EQU CYREG_NVIC_CLRENA0
USBUART_ep_0__INTC_CLR_PD_REG EQU CYREG_NVIC_CLRPEND0
USBUART_ep_0__INTC_MASK EQU 0x1000000
USBUART_ep_0__INTC_NUMBER EQU 24
USBUART_ep_0__INTC_PRIOR_NUM EQU 7
USBUART_ep_0__INTC_PRIOR_REG EQU CYREG_NVIC_PRI_24
USBUART_ep_0__INTC_SET_EN_REG EQU CYREG_NVIC_SETENA0
USBUART_ep_0__INTC_SET_PD_REG EQU CYREG_NVIC_SETPEND0

; USBUART_ep_1
USBUART_ep_1__INTC_CLR_EN_REG EQU CYREG_NVIC_CLRENA0
USBUART_ep_1__INTC_CLR_PD_REG EQU CYREG_NVIC_CLRPEND0
USBUART_ep_1__INTC_MASK EQU 0x01
USBUART_ep_1__INTC_NUMBER EQU 0
USBUART_ep_1__INTC_PRIOR_NUM EQU 7
USBUART_ep_1__INTC_PRIOR_REG EQU CYREG_NVIC_PRI_0
USBUART_ep_1__INTC_SET_EN_REG EQU CYREG_NVIC_SETENA0
USBUART_ep_1__INTC_SET_PD_REG EQU CYREG_NVIC_SETPEND0

; USBUART_ep_2
USBUART_ep_2__INTC_CLR_EN_REG EQU CYREG_NVIC_CLRENA0
USBUART_ep_2__INTC_CLR_PD_REG EQU CYREG_NVIC_CLRPEND0
USBUART_ep_2__INTC_MASK EQU 0x02
USBUART_ep_2__INTC_NUMBER EQU 1
USBUART_ep_2__INTC_PRIOR_NUM EQU 7
USBUART_ep_2__INTC_PRIOR_REG EQU CYREG_NVIC_PRI_1
USBUART_ep_2__INTC_SET_EN_REG EQU CYREG_NVIC_SETENA0
USBUART_ep_2__INTC_SET_PD_REG EQU CYREG_NVIC_SETPEND0

; USBUART_ep_3
USBUART_ep_3__INTC_CLR_EN_REG EQU CYREG_NVIC_CLRENA0
USBUART_ep_3__INTC_CLR_PD_REG EQU CYREG_NVIC_CLRPEND0
USBUART_ep_3__INTC_MASK EQU 0x04
USBUART_ep_3__INTC_NUMBER EQU 2
USBUART_ep_3__INTC_PRIOR_NUM EQU 7
USBUART_ep_3__INTC_PRIOR_REG EQU CYREG_NVIC_PRI_2
USBUART_ep_3__INTC_SET_EN_REG EQU CYREG_NVIC_SETENA0
USBUART_ep_3__INTC_SET_PD_REG EQU CYREG_NVIC_SETPEND0

; USBUART_sof_int
USBUART_sof_int__INTC_CLR_EN_REG EQU CYREG_NVIC_CLRENA0
USBUART_sof_int__INTC_CLR_PD_REG EQU CYREG_NVIC_CLRPEND0
USBUART_sof_int__INTC_MASK EQU 0x200000
USBUART_sof_int__INTC_NUMBER EQU 21
USBUART_sof_int__INTC_PRIOR_NUM EQU 7
USBUART_sof_int__INTC_PRIOR_REG EQU CYREG_NVIC_PRI_21
USBUART_sof_int__INTC_SET_EN_REG EQU CYREG_NVIC_SETENA0
USBUART_sof_int__INTC_SET_PD_REG EQU CYREG_NVIC_SETPEND0

; USBUART_USB
USBUART_USB__ARB_CFG EQU CYREG_USB_ARB_CFG
USBUART_USB__ARB_EP1_CFG EQU CYREG_USB_ARB_EP1_CFG
USBUART_USB__ARB_EP1_INT_EN EQU CYREG_USB_ARB_EP1_INT_EN
USBUART_USB__ARB_EP1_SR EQU CYREG_USB_ARB_EP1_SR
USBUART_USB__ARB_EP2_CFG EQU CYREG_USB_ARB_EP2_CFG
USBUART_USB__ARB_EP2_INT_EN EQU CYREG_USB_ARB_EP2_INT_EN
USBUART_USB__ARB_EP2_SR EQU CYREG_USB_ARB_EP2_SR
USBUART_USB__ARB_EP3_CFG EQU CYREG_USB_ARB_EP3_CFG
USBUART_USB__ARB_EP3_INT_EN EQU CYREG_USB_ARB_EP3_INT_EN
USBUART_USB__ARB_EP3_SR EQU CYREG_USB_ARB_EP3_SR
USBUART_USB__ARB_EP4_CFG EQU CYREG_USB_ARB_EP4_CFG
USBUART_USB__ARB_EP4_INT_EN EQU CYREG_USB_ARB_EP4_INT_EN
USBUART_USB__ARB_EP4_SR EQU CYREG_USB_ARB_EP4_SR
USBUART_USB__ARB_EP5_CFG EQU CYREG_USB_ARB_EP5_CFG
USBUART_USB__ARB_EP5_INT_EN EQU CYREG_USB_ARB_EP5_INT_EN
USBUART_USB__ARB_EP5_SR EQU CYREG_USB_ARB_EP5_SR
USBUART_USB__ARB_EP6_CFG EQU CYREG_USB_ARB_EP6_CFG
USBUART_USB__ARB_EP6_INT_EN EQU CYREG_USB_ARB_EP6_INT_EN
USBUART_USB__ARB_EP6_SR EQU CYREG_USB_ARB_EP6_SR
USBUART_USB__ARB_EP7_CFG EQU CYREG_USB_ARB_EP7_CFG
USBUART_USB__ARB_EP7_INT_EN EQU CYREG_USB_ARB_EP7_INT_EN
USBUART_USB__ARB_EP7_SR EQU CYREG_USB_ARB_EP7_SR
USBUART_USB__ARB_EP8_CFG EQU CYREG_USB_ARB_EP8_CFG
USBUART_USB__ARB_EP8_INT_EN EQU CYREG_USB_ARB_EP8_INT_EN
USBUART_USB__ARB_EP8_SR EQU CYREG_USB_ARB_EP8_SR
USBUART_USB__ARB_INT_EN EQU CYREG_USB_ARB_INT_EN
USBUART_USB__ARB_INT_SR EQU CYREG_USB_ARB_INT_SR
USBUART_USB__ARB_RW1_DR EQU CYREG_USB_ARB_RW1_DR
USBUART_USB__ARB_RW1_RA EQU CYREG_USB_ARB_RW1_RA
USBUART_USB__ARB_RW1_RA_MSB EQU CYREG_USB_ARB_RW1_RA_MSB
USBUART_USB__ARB_RW1_WA EQU CYREG_USB_ARB_RW1_WA
USBUART_USB__ARB_RW1_WA_MSB EQU CYREG_USB_ARB_RW1_WA_MSB
USBUART_USB__ARB_RW2_DR EQU CYREG_USB_ARB_RW2_DR
USBUART_USB__ARB_RW2_RA EQU CYREG_USB_ARB_RW2_RA
USBUART_USB__ARB_RW2_RA_MSB EQU CYREG_USB_ARB_RW2_RA_MSB
USBUART_USB__ARB_RW2_WA EQU CYREG_USB_ARB_RW2_WA
USBUART_USB__ARB_RW2_WA_MSB EQU CYREG_USB_ARB_RW2_WA_MSB
USBUART_USB__ARB_RW3_DR EQU CYREG_USB_ARB_RW3_DR
USBUART_USB__ARB_RW3_RA EQU CYREG_USB_ARB_RW3_RA
USBUART_USB__ARB_RW3_RA_MSB EQU CYREG_USB_ARB_RW3_RA_MSB
USBUART_USB__ARB_RW3_WA EQU CYREG_USB_ARB_RW3_WA
USBUART_USB__ARB_RW3_WA_MSB EQU CYREG_USB_ARB_RW3_WA_MSB
USBUART_USB__ARB_RW4_DR EQU CYREG_USB_ARB_RW4_DR
USBUART_USB__ARB_RW4_RA EQU CYREG_USB_ARB_RW4_RA
USBUART_USB__ARB_RW4_RA_MSB EQU CYREG_USB_ARB_RW4_RA_MSB
USBUART_USB__ARB_RW4_WA EQU CYREG_USB_ARB_RW4_WA
USBUART_USB__ARB_RW4_WA_MSB EQU CYREG_USB_ARB_RW4_WA_MSB
USBUART_USB__ARB_RW5_DR EQU CYREG_USB_ARB_RW5_DR
USBUART_USB__ARB_RW5_RA EQU CYREG_USB_ARB_RW5_RA
USBUART_USB__ARB_RW5_RA_MSB EQU CYREG_USB_ARB_RW5_RA_MSB
USBUART_USB__ARB_RW5_WA EQU CYREG_USB_ARB_RW5_WA
USBUART_USB__ARB_RW5_WA_MSB EQU CYREG_USB_ARB_RW5_WA_MSB
USBUART_USB__ARB_RW6_DR EQU CYREG_USB_ARB_RW6_DR
USBUART_USB__ARB_RW6_RA EQU CYREG_USB_ARB_RW6_RA
USBUART_USB__ARB_RW6_RA_MSB EQU CYREG_USB_ARB_RW6_RA_MSB
USBUART_USB__ARB_RW6_WA EQU CYREG_USB_ARB_RW6_WA
USBUART_USB__ARB_RW6_WA_MSB EQU CYREG_USB_ARB_RW6_WA_MSB
USBUART_USB__ARB_RW7_DR EQU CYREG_USB_ARB_RW7_DR
USBUART_USB__ARB_RW7_RA EQU CYREG_USB_ARB_RW7_RA
USBUART_USB__ARB_RW7_RA_MSB EQU CYREG_USB_ARB_RW7_RA_MSB
USBUART_USB__ARB_RW7_WA EQU CYREG_USB_ARB_RW7_WA
USBUART_USB__ARB_RW7_WA_MSB EQU CYREG_USB_ARB_RW7_WA_MSB
USBUART_USB__ARB_RW8_DR EQU CYREG_USB_ARB_RW8_DR
USBUART_USB__ARB_RW8_RA EQU CYREG_USB_ARB_RW8_RA
USBUART_USB__ARB_RW8_RA_MSB EQU CYREG_USB_ARB_RW8_RA_MSB
USBUART_USB__ARB_RW8_WA EQU CYREG_USB_ARB_RW8_WA
USBUART_USB__ARB_RW8_WA_MSB EQU CYREG_USB_ARB_RW8_WA_MSB
USBUART_USB__BUF_SIZE EQU CYREG_USB_BUF_SIZE
USBUART_USB__BUS_RST_CNT EQU CYREG_USB_BUS_RST_CNT
USBUART_USB__CR0 EQU CYREG_USB_CR0
USBUART_USB__CR1 EQU CYREG_USB_CR1
USBUART_USB__CWA EQU CYREG_USB_CWA
USBUART_USB__CWA_MSB EQU CYREG_USB_CWA_MSB
USBUART_USB__DMA_THRES EQU CYREG_USB_DMA_THRES
USBUART_USB__DMA_THRES_MSB EQU CYREG_USB_DMA_THRES_MSB
USBUART_USB__DYN_RECONFIG EQU CYREG_USB_DYN_RECONFIG
USBUART_USB__EP_ACTIVE EQU CYREG_USB_EP_ACTIVE
USBUART_USB__EP_TYPE EQU CYREG_USB_EP_TYPE
USBUART_USB__EP0_CNT EQU CYREG_USB_EP0_CNT
USBUART_USB__EP0_CR EQU CYREG_USB_EP0_CR
USBUART_USB__EP0_DR0 EQU CYREG_USB_EP0_DR0
USBUART_USB__EP0_DR1 EQU CYREG_USB_EP0_DR1
USBUART_USB__EP0_DR2 EQU CYREG_USB_EP0_DR2
USBUART_USB__EP0_DR3 EQU CYREG_USB_EP0_DR3
USBUART_USB__EP0_DR4 EQU CYREG_USB_EP0_DR4
USBUART_USB__EP0_DR5 EQU CYREG_USB_EP0_DR5
USBUART_USB__EP0_DR6 EQU CYREG_USB_EP0_DR6
USBUART_USB__EP0_DR7 EQU CYREG_USB_EP0_DR7
USBUART_USB__MEM_DATA EQU CYREG_USB_MEM_DATA_MBASE
USBUART_USB__PM_ACT_CFG EQU CYREG_PM_ACT_CFG5
USBUART_USB__PM_ACT_MSK EQU 0x01
USBUART_USB__PM_STBY_CFG EQU CYREG_PM_STBY_CFG5
USBUART_USB__PM_STBY_MSK EQU 0x01
USBUART_USB__SIE_EP_INT_EN EQU CYREG_USB_SIE_EP_INT_EN
USBUART_USB__SIE_EP_INT_SR EQU CYREG_USB_SIE_EP_INT_SR
USBUART_USB__SIE_EP1_CNT0 EQU CYREG_USB_SIE_EP1_CNT0
USBUART_USB__SIE_EP1_CNT1 EQU CYREG_USB_SIE_EP1_CNT1
USBUART_USB__SIE_EP1_CR0 EQU CYREG_USB_SIE_EP1_CR0
USBUART_USB__SIE_EP2_CNT0 EQU CYREG_USB_SIE_EP2_CNT0
USBUART_USB__SIE_EP2_CNT1 EQU CYREG_USB_SIE_EP2_CNT1
USBUART_USB__SIE_EP2_CR0 EQU CYREG_USB_SIE_EP2_CR0
USBUART_USB__SIE_EP3_CNT0 EQU CYREG_USB_SIE_EP3_CNT0
USBUART_USB__SIE_EP3_CNT1 EQU CYREG_USB_SIE_EP3_CNT1
USBUART_USB__SIE_EP3_CR0 EQU CYREG_USB_SIE_EP3_CR0
USBUART_USB__SIE_EP4_CNT0 EQU CYREG_USB_SIE_EP4_CNT0
USBUART_USB__SIE_EP4_CNT1 EQU CYREG_USB_SIE_EP4_CNT1
USBUART_USB__SIE_EP4_CR0 EQU CYREG_USB_SIE_EP4_CR0
USBUART_USB__SIE_EP5_CNT0 EQU CYREG_USB_SIE_EP5_CNT0
USBUART_USB__SIE_EP5_CNT1 EQU CYREG_USB_SIE_EP5_CNT1
USBUART_USB__SIE_EP5_CR0 EQU CYREG_USB_SIE_EP5_CR0
USBUART_USB__SIE_EP6_CNT0 EQU CYREG_USB_SIE_EP6_CNT0
USBUART_USB__SIE_EP6_CNT1 EQU CYREG_USB_SIE_EP6_CNT1
USBUART_USB__SIE_EP6_CR0 EQU CYREG_USB_SIE_EP6_CR0
USBUART_USB__SIE_EP7_CNT0 EQU CYREG_USB_SIE_EP7_CNT0
USBUART_USB__SIE_EP7_CNT1 EQU CYREG_USB_SIE_EP7_CNT1
USBUART_USB__SIE_EP7_CR0 EQU CYREG_USB_SIE_EP7_CR0
USBUART_USB__SIE_EP8_CNT0 EQU CYREG_USB_SIE_EP8_CNT0
USBUART_USB__SIE_EP8_CNT1 EQU CYREG_USB_SIE_EP8_CNT1
USBUART_USB__SIE_EP8_CR0 EQU CYREG_USB_SIE_EP8_CR0
USBUART_USB__SOF0 EQU CYREG_USB_SOF0
USBUART_USB__SOF1 EQU CYREG_USB_SOF1
USBUART_USB__USB_CLK_EN EQU CYREG_USB_USB_CLK_EN
USBUART_USB__USBIO_CR0 EQU CYREG_USB_USBIO_CR0
USBUART_USB__USBIO_CR1 EQU CYREG_USB_USBIO_CR1

; Miscellaneous
BCLK__BUS_CLK__HZ EQU 24000000
BCLK__BUS_CLK__KHZ EQU 24000
BCLK__BUS_CLK__MHZ EQU 24
CYDEV_CHIP_DIE_LEOPARD EQU 1
CYDEV_CHIP_DIE_PANTHER EQU 19
CYDEV_CHIP_DIE_PSOC4A EQU 11
CYDEV_CHIP_DIE_PSOC5LP EQU 18
CYDEV_CHIP_DIE_TMA4 EQU 2
CYDEV_CHIP_DIE_UNKNOWN EQU 0
CYDEV_CHIP_FAMILY_PSOC3 EQU 1
CYDEV_CHIP_FAMILY_PSOC4 EQU 2
CYDEV_CHIP_FAMILY_PSOC5 EQU 3
CYDEV_CHIP_FAMILY_UNKNOWN EQU 0
CYDEV_CHIP_FAMILY_USED EQU CYDEV_CHIP_FAMILY_PSOC5
CYDEV_CHIP_JTAG_ID EQU 0x2E123069
CYDEV_CHIP_MEMBER_3A EQU 1
CYDEV_CHIP_MEMBER_4A EQU 11
CYDEV_CHIP_MEMBER_4C EQU 16
CYDEV_CHIP_MEMBER_4D EQU 7
CYDEV_CHIP_MEMBER_4E EQU 4
CYDEV_CHIP_MEMBER_4F EQU 12
CYDEV_CHIP_MEMBER_4G EQU 2
CYDEV_CHIP_MEMBER_4H EQU 10
CYDEV_CHIP_MEMBER_4I EQU 15
CYDEV_CHIP_MEMBER_4J EQU 8
CYDEV_CHIP_MEMBER_4K EQU 9
CYDEV_CHIP_MEMBER_4L EQU 14
CYDEV_CHIP_MEMBER_4M EQU 13
CYDEV_CHIP_MEMBER_4N EQU 6
CYDEV_CHIP_MEMBER_4O EQU 5
CYDEV_CHIP_MEMBER_4U EQU 3
CYDEV_CHIP_MEMBER_5A EQU 18
CYDEV_CHIP_MEMBER_5B EQU 17
CYDEV_CHIP_MEMBER_UNKNOWN EQU 0
CYDEV_CHIP_MEMBER_USED EQU CYDEV_CHIP_MEMBER_5B
CYDEV_CHIP_DIE_EXPECT EQU CYDEV_CHIP_MEMBER_USED
CYDEV_CHIP_DIE_ACTUAL EQU CYDEV_CHIP_DIE_EXPECT
CYDEV_CHIP_REV_LEOPARD_ES1 EQU 0
CYDEV_CHIP_REV_LEOPARD_ES2 EQU 1
CYDEV_CHIP_REV_LEOPARD_ES3 EQU 3
CYDEV_CHIP_REV_LEOPARD_PRODUCTION EQU 3
CYDEV_CHIP_REV_PANTHER_ES0 EQU 0
CYDEV_CHIP_REV_PANTHER_ES1 EQU 1
CYDEV_CHIP_REV_PANTHER_PRODUCTION EQU 1
CYDEV_CHIP_REV_PSOC4A_ES0 EQU 17
CYDEV_CHIP_REV_PSOC4A_PRODUCTION EQU 17
CYDEV_CHIP_REV_PSOC5LP_ES0 EQU 0
CYDEV_CHIP_REV_PSOC5LP_PRODUCTION EQU 0
CYDEV_CHIP_REV_TMA4_ES EQU 17
CYDEV_CHIP_REV_TMA4_ES2 EQU 33
CYDEV_CHIP_REV_TMA4_PRODUCTION EQU 17
CYDEV_CHIP_REVISION_3A_ES1 EQU 0
CYDEV_CHIP_REVISION_3A_ES2 EQU 1
CYDEV_CHIP_REVISION_3A_ES3 EQU 3
CYDEV_CHIP_REVISION_3A_PRODUCTION EQU 3
CYDEV_CHIP_REVISION_4A_ES0 EQU 17
CYDEV_CHIP_REVISION_4A_PRODUCTION EQU 17
CYDEV_CHIP_REVISION_4C_PRODUCTION EQU 0
CYDEV_CHIP_REVISION_4D_PRODUCTION EQU 0
CYDEV_CHIP_REVISION_4E_PRODUCTION EQU 0
CYDEV_CHIP_REVISION_4F_PRODUCTION EQU 0
CYDEV_CHIP_REVISION_4F_PRODUCTION_256DMA EQU 0
CYDEV_CHIP_REVISION_4F_PRODUCTION_256K EQU 0
CYDEV_CHIP_REVISION_4G_ES EQU 17
CYDEV_CHIP_REVISION_4G_ES2 EQU 33
CYDEV_CHIP_REVISION_4G_PRODUCTION EQU 17
CYDEV_CHIP_REVISION_4H_PRODUCTION EQU 0
CYDEV_CHIP_REVISION_4I_PRODUCTION EQU 0
CYDEV_CHIP_REVISION_4J_PRODUCTION EQU 0
CYDEV_CHIP_REVISION_4K_PRODUCTION EQU 0
CYDEV_CHIP_REVISION_4L_PRODUCTION EQU 0
CYDEV_CHIP_REVISION_4M_PRODUCTION EQU 0
CYDEV_CHIP_REVISION_4N_PRODUCTION EQU 0
CYDEV_CHIP_REVISION_4O_PRODUCTION EQU 0
CYDEV_CHIP_REVISION_4U_PRODUCTION EQU 0
CYDEV_CHIP_REVISION_5A_ES0 EQU 0
CYDEV_CHIP_REVISION_5A_ES1 EQU 1
CYDEV_CHIP_REVISION_5A_PRODUCTION EQU 1
CYDEV_CHIP_REVISION_5B_ES0 EQU 0
CYDEV_CHIP_REVISION_5B_PRODUCTION EQU 0
CYDEV_CHIP_REVISION_USED EQU CYDEV_CHIP_REVISION_5B_PRODUCTION
CYDEV_CHIP_REV_EXPECT EQU CYDEV_CHIP_REVISION_USED
CYDEV_CONFIG_FASTBOOT_ENABLED EQU 1
CYDEV_CONFIG_UNUSED_IO_AllowButWarn EQU 0
CYDEV_CONFIG_UNUSED_IO EQU CYDEV_CONFIG_UNUSED_IO_AllowButWarn
CYDEV_CONFIG_UNUSED_IO_AllowWithInfo EQU 1
CYDEV_CONFIG_UNUSED_IO_Disallowed EQU 2
CYDEV_CONFIGURATION_COMPRESSED EQU 1
CYDEV_CONFIGURATION_DMA EQU 0
CYDEV_CONFIGURATION_ECC EQU 1
CYDEV_CONFIGURATION_IMOENABLED EQU CYDEV_CONFIG_FASTBOOT_ENABLED
CYDEV_CONFIGURATION_MODE_COMPRESSED EQU 0
CYDEV_CONFIGURATION_MODE EQU CYDEV_CONFIGURATION_MODE_COMPRESSED
CYDEV_CONFIGURATION_MODE_DMA EQU 2
CYDEV_CONFIGURATION_MODE_UNCOMPRESSED EQU 1
CYDEV_DEBUG_ENABLE_MASK EQU 0x20
CYDEV_DEBUG_ENABLE_REGISTER EQU CYREG_MLOGIC_DEBUG
CYDEV_DEBUGGING_DPS_Disable EQU 3
CYDEV_DEBUGGING_DPS_JTAG_4 EQU 1
CYDEV_DEBUGGING_DPS_JTAG_5 EQU 0
CYDEV_DEBUGGING_DPS_SWD EQU 2
CYDEV_DEBUGGING_DPS_SWD_SWV EQU 6
CYDEV_DEBUGGING_DPS EQU CYDEV_DEBUGGING_DPS_SWD_SWV
CYDEV_DEBUGGING_ENABLE EQU 1
CYDEV_DEBUGGING_XRES EQU 0
CYDEV_DMA_CHANNELS_AVAILABLE EQU 24
CYDEV_ECC_ENABLE EQU 0
CYDEV_HEAP_SIZE EQU 0x80
CYDEV_INSTRUCT_CACHE_ENABLED EQU 1
CYDEV_INTR_RISING EQU 0x00000000
CYDEV_IS_EXPORTING_CODE EQU 0
CYDEV_IS_IMPORTING_CODE EQU 0
CYDEV_PROJ_TYPE EQU 0
CYDEV_PROJ_TYPE_BOOTLOADER EQU 1
CYDEV_PROJ_TYPE_LAUNCHER EQU 5
CYDEV_PROJ_TYPE_LOADABLE EQU 2
CYDEV_PROJ_TYPE_LOADABLEANDBOOTLOADER EQU 4
CYDEV_PROJ_TYPE_MULTIAPPBOOTLOADER EQU 3
CYDEV_PROJ_TYPE_STANDARD EQU 0
CYDEV_PROTECTION_ENABLE EQU 0
CYDEV_STACK_SIZE EQU 0x0800
CYDEV_USB_CLK_OSC_LOCKING_ENABLED_AT_PWR_UP EQU 1
CYDEV_USE_BUNDLED_CMSIS EQU 1
CYDEV_VARIABLE_VDDA EQU 0
CYDEV_VDDA_MV EQU 5000
CYDEV_VDDD_MV EQU 5000
CYDEV_VDDIO0_MV EQU 5000
CYDEV_VDDIO1_MV EQU 5000
CYDEV_VDDIO2_MV EQU 5000
CYDEV_VDDIO3_MV EQU 5000
CYDEV_VIO0_MV EQU 5000
CYDEV_VIO1_MV EQU 5000
CYDEV_VIO2_MV EQU 5000
CYDEV_VIO3_MV EQU 5000
CYIPBLOCK_ARM_CM3_VERSION EQU 0
CYIPBLOCK_P3_ANAIF_VERSION EQU 0
CYIPBLOCK_P3_CAN_VERSION EQU 0
CYIPBLOCK_P3_CAPSENSE_VERSION EQU 0
CYIPBLOCK_P3_COMP_VERSION EQU 0
CYIPBLOCK_P3_DECIMATOR_VERSION EQU 0
CYIPBLOCK_P3_DFB_VERSION EQU 0
CYIPBLOCK_P3_DMA_VERSION EQU 0
CYIPBLOCK_P3_DRQ_VERSION EQU 0
CYIPBLOCK_P3_DSM_VERSION EQU 0
CYIPBLOCK_P3_EMIF_VERSION EQU 0
CYIPBLOCK_P3_I2C_VERSION EQU 0
CYIPBLOCK_P3_LCD_VERSION EQU 0
CYIPBLOCK_P3_LPF_VERSION EQU 0
CYIPBLOCK_P3_OPAMP_VERSION EQU 0
CYIPBLOCK_P3_PM_VERSION EQU 0
CYIPBLOCK_P3_SCCT_VERSION EQU 0
CYIPBLOCK_P3_TIMER_VERSION EQU 0
CYIPBLOCK_P3_USB_VERSION EQU 0
CYIPBLOCK_P3_VIDAC_VERSION EQU 0
CYIPBLOCK_P3_VREF_VERSION EQU 0
CYIPBLOCK_S8_GPIO_VERSION EQU 0
CYIPBLOCK_S8_IRQ_VERSION EQU 0
CYIPBLOCK_S8_SAR_VERSION EQU 0
CYIPBLOCK_S8_SIO_VERSION EQU 0
CYIPBLOCK_S8_UDB_VERSION EQU 0
DMA_CHANNELS_USED__MASK0 EQU 0x00000000
CYDEV_BOOTLOADER_ENABLE EQU 0
    ENDIF
    END
